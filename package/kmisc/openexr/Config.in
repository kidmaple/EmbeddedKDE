## package/kmisc/openexr/Config.in
```kconfig
config BR2_PACKAGE_OPENEXR
	bool "openexr"
	help
	  OpenEXR is a high dynamic-range (HDR) image file format developed by Industrial Light & Magic for use in computer imaging applications.

	  http://www.openexr.com/
```

## package/kmisc/polkit/Config.in
```kconfig
config BR2_PACKAGE_POLKIT
	bool "Polkit"
	help
	  The OpenLDAP Project is a collaborative effort to develop a robust, commercial-grade, fully featured, and open source LDAP suite of applications and development tools. The project is managed by a worldwide community of volunteers that use the Internet to communicate, plan, and develop the OpenLDAP Suite and its related documentation.

	  http://www.openldap.org/
```

## package/kmisc/pstoedit/Config.in
```kconfig
config BR2_PACKAGE_PSTOEDIT
	bool "pstoedit"
	help
	  pstoedit translates PostScript and PDF graphics into other vector formats.

	  http://www.pstoedit.net/
```

## package/kmisc/qrencode/Config.in
```kconfig
config BR2_PACKAGE_QRENCODE
	bool "qrencode"
#	depends on BR2_PACKAGE_QT && BR2_PACKAGE_AUTOMOC4
	help
	  prison is a barcode api currently offering a nice Qt api to produce QRCode barcodes and DataMatrix barcodes, and can easily be made support more.

	  http://kde.mirror.aussiehq.net.au/stable/cagibi/
```

## package/kmisc/rasqal/Config.in
```kconfig
config BR2_PACKAGE_RASQAL
	bool "raptor"
	help
	  Redland is a set of free software C libraries that provide support for the Resource Description Framework (RDF).

	  http://librdf.org/
```

## package/kmisc/redland-binding/Config.in
```kconfig
config BR2_PACKAGE_REDLAND_BINDING
	bool "redland-binding"
	help
	  Redland is a set of free software C libraries that provide support for the Resource Description Framework (RDF).

	  http://librdf.org/
```

## package/kmisc/redland/Config.in
```kconfig
config BR2_PACKAGE_REDLAND
	bool "redland"
	help
	  Redland is a set of free software C libraries that provide support for the Resource Description Framework (RDF).

	  http://librdf.org/
```

## package/kmisc/sasl2/Config.in
```kconfig
config BR2_PACKAGE_SASL2
	bool "sasl2"
#	depends on BR2_PACKAGE_QT && BR2_PACKAGE_AUTOMOC4
	help
	  prison is a barcode api currently offering a nice Qt api to produce QRCode barcodes and DataMatrix barcodes, and can easily be made support more.

	  http://kde.mirror.aussiehq.net.au/stable/cagibi/
```

## package/ksupport/Config.in
```kconfig
comment "KDE Support"
	depends on !BR2_PACKAGE_QT

menuconfig BR2_PACKAGE_KSUPPORT
	bool "KDE support libraries"
	depends on BR2_PACKAGE_QT
	help
		The current official Software Compilation consists of the following packages, many of which contain multiple applications and/or libraries:
		KDE-Libs: The software libraries that compose the KDE Developer Platform, required by all KDE applications.
		KDE-Base:
			Runtime: Additional software components required by many KDE Applications to perform properly.
			Applications: Applications that are central to a basic desktop experience, such as a file manager or web browser.
			Workspace: The KDE Workspaces that provide the tools and user environments for a Desktop, Netbook or Mobile experience
		KDE-Plasma-Addons: Additional themes and applets for the desktop and panel.
		KDE-Network: Networking applications such as an instant messenger and download manager.
		KDE-Pim: Mail client, addressbook, organizer and groupware integration.
		KDE-Graphics: Document viewer, image viewer and selected other graphics applications.
		KDE-Multimedia: Includes a video player as well as different audio players.
		Phonon: Multimedia layer that supports different backends, on different operating systems, for multimedia output.
		KDE-Accessibility: Applications to improve computer access for disabled people such as a text-to-speech system.
		KDE-Utilities: Useful utilities like an archiving tool and a calculator.
		KDE-Edu: Education and science applications.
		KDE-Games: Classic and modern games.
		KDE-Toys: KDE's fun stuff.
		KDE-Artwork: Additional icons, styles, wallpapers, screensavers and window decorations.
		KDE-Admin: Various tools to aid with system administration.
		KDE-SDK: Script and tools which simplify development of KDE applications.
		KDE-Bindings: bindings for various programming languages (Python, Ruby, Perl, Java...).

		http://www.kde.org/
		http://download.kde.org/mirrorstatus.html
		http://kde.mirror.aussiehq.net.au/stable/
		https://projects.kde.org/projects/kde
		http://mirrors.isc.org/pub/kde/stable/
		ftp://ftp.kde.org/pub/kde/stable/

if BR2_PACKAGE_KSUPPORT
source "package/ksupport/akonadi/Config.in"
source "package/ksupport/attica/Config.in"
#source "package/ksupport/automoc4/Config.in"
source "package/ksupport/cagibi/Config.in"
source "package/ksupport/phonon/Config.in"
#source "package/ksupport/qca2/Config.in"
source "package/ksupport/polkit-qt-1/Config.in"
source "package/ksupport/prison/Config.in"
#source "package/ksupport/qimageblitz/Config.in"
source "package/ksupport/libqzeitgeist/Config.in"
#source "package/ksupport/qttools/Config.in"
#source "package/ksupport/qtdata/Config.in"
source "package/ksupport/soprano/Config.in"
source "package/ksupport/strigi/Config.in"
#source "package/ksupport/extra-cmake/Config.in"
endif
```

## package/ksupport/akonadi/Config.in
```kconfig
config BR2_PACKAGE_AKONADI
	bool "akonadi"
#	depends on BR2_PACKAGE_QT && BR2_PACKAGE_AUTOMOC4
	help
	  Akonadi Server. A cross-desktop storage service for PIM data and meta data providing concurrent read, write, and query access.

	  https://projects.kde.org/projects/kdesupport/akonadi
	  http://pim.kde.org/akonadi/
```

## package/ksupport/attica/Config.in
```kconfig
config BR2_PACKAGE_ATTICA
	bool "attica"
#	depends on BR2_PACKAGE_QT && BR2_PACKAGE_AUTOMOC4
	help
	  Akonadi Server. A cross-desktop storage service for PIM data and meta data providing concurrent read, write, and query access.

	  http://kde.mirror.aussiehq.net.au/stable/attica/
```

## package/ksupport/extra-cmake/Config.in
```kconfig
config BR2_PACKAGE_EXTRA_CMAKE
	bool "Extra Cmake"
	help
	  Extra modules and scripts for CMake

	  https://projects.kde.org/projects/kdesupport/extra-cmake-modules
```

## package/ksupport/libqzeitgeist/Config.in
```kconfig
config BR2_PACKAGE_LIBQZEITGEIST
	bool "Qt Zeigeist"
	help
	  A Qt interface to the Zeitgeist event tracking system

	  https://projects.kde.org/projects/kdesupport/libqzeitgeist
```

## package/ksupport/libstreamanalyzer/Config.in
```kconfig
config BR2_PACKAGE_LIBSTREAMANALYZER
	bool "libstreamanalyzer"
	help
	  Strigi libstreamanalyzer.

	  https://projects.kde.org/projects/kdesupport/strigi
```

## package/ksupport/libstreams/Config.in
```kconfig
config BR2_PACKAGE_LIBSTREAMS
	bool "libstreams"
	help
	  Strigi libstreams.

	  https://projects.kde.org/projects/kdesupport/strigi
```

## package/ksupport/oscaf/Config.in
```kconfig
config BR2_PACKAGE_OSCAF
	bool "kdepimlibs"
	help
	  Open Semantic Collaboration Architecture Foundation (OSCAF) ontologies and reference code development. This project is used maintainers from open source projects to maintain standards for the interoperability of desktop and web applications.

	  http://sourceforge.net/projects/oscaf
```

## package/ksupport/phonon/Config.in
```kconfig
config BR2_PACKAGE_PHONON
	bool "phonon"
	help
	  The Phonon multimedia library and its backend plugins.

	  http://phonon.kde.org/
```

## package/ksupport/polkit-kde-1/Config.in
```kconfig
config BR2_PACKAGE_POLKIT_KDE_1
	bool "polkit-kde-1"
#	depends on BR2_PACKAGE_QT && BR2_PACKAGE_AUTOMOC4
	help
	 Qt wrapper around polkit-1 client libraries, used by kdelibs to provide the polkit-1 kauth backend and by KDE's polkit client.

	  https://projects.kde.org/projects/kdesupport/akonadi
	  http://pim.kde.org/akonadi/
```

## package/ksupport/qimageblitz/Config.in
```kconfig
config BR2_PACKAGE_QIMAGEBLITZ
	bool "qimageblitz"
#	depends on BR2_PACKAGE_QT
	help
	  automoc4 is a tool to add rules for generating Qt moc files automatically to projects that use CMake as the buildsystem.

	  http://mirrors.isc.org/pub/kde/stable/automoc4/
```

## package/ksupport/qtdata/Config.in
```kconfig
config BR2_PACKAGE_QTDATA
	bool "Library meta data for Inqlude"
	help
	  Library meta data for Inqlude, the Qt library archive

	  https://projects.kde.org/projects/kdesupport
```

## package/ksupport/qttools/Config.in
```kconfig
config BR2_PACKAGE_QTTOOLS
	bool "Qt tools for Inqlude"
	help
	  Tools for Inqlude, the Qt library archive.

	  https://projects.kde.org/projects/kdesupport
```

## package/ksupport/strigi/Config.in
```kconfig
config BR2_PACKAGE_STRIGI
	bool "strigi"
#	depends on BR2_PACKAGE_QT && BR2_PACKAGE_AUTOMOC4
	help
	  Akonadi Server. A cross-desktop storage service for PIM data and meta data providing concurrent read, write, and query access.

	  http://www.vandenoever.info/software/strigi/
```

## package/ksupport/strigiclient/Config.in
```kconfig
config BR2_PACKAGE_STRIGICLIENT
	bool "strigiclient"
	help
	  Strigi strigiclient.

	  https://projects.kde.org/projects/kdesupport/strigi
```

## package/ksupport/strigidaemon/Config.in
```kconfig
config BR2_PACKAGE_STRIGIDAEMON
	bool "strigidaemon"
	help
	  Strigi strigidaemon.

	  https://projects.kde.org/projects/kdesupport/strigi
```

## package/ksupport/strigiutils/Config.in
```kconfig
config BR2_PACKAGE_STRIGIUTILS
	bool "strigiutils"
	help
	  Strigi strigiutils.

	  https://projects.kde.org/projects/kdesupport/strigi
```
