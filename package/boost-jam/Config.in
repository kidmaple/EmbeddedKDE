## package/boost-jam/Config.in
```kconfig
config BR2_PACKAGE_BOOST_JAM
	bool "boost-jam"
	help
	  boost-jam app for the host. needed to build boost
```

## package/boost/Config.in
```kconfig
config BR2_PACKAGE_BOOST
	bool "boost"
    select BR2_PACKAGE_BOOST_JAM
	help
	  boost
```

## package/gcrypt/Config.in
```kconfig
menu "Gcrypt libraries"
source "package/gcrypt/gnupg/Config.in"
source "package/gcrypt/gpgme/Config.in"
source "package/gcrypt/libassuan/Config.in"
source "package/gcrypt/libksda/Config.in"
source "package/gcrypt/pth/Config.in"
endmenu
```

## package/gcrypt/gnupg/Config.in
```kconfig
config BR2_PACKAGE_GNUPG
	bool "GnuPG"
	help
	  GnuPG Made Easy (GNUPG) is a library designed to make access to GnuPG easier for applications. It provides a High-Level Crypto API for encryption, decryption, signing, signature verification and key management. Currently it uses GnuPG as its backend but the API isn't restricted to this engine; in fact we have already developed a backend for CMS (S/MIME).

	  http://www.gnupg.org/related_software/gpgme/
```

## package/gcrypt/gpa/Config.in
```kconfig
config BR2_PACKAGE_GPA
	bool "GnuPG"
	help
	  GPA is still work in progress, so don't expect that everything works and be careful when using production quality secret keys.

	  http://www.gnupg.org/related_software/gpgme/
```

## package/gcrypt/gpgme/Config.in
```kconfig
config BR2_PACKAGE_GPGME
	bool "GPGME"
	help
	  GnuPG Made Easy (GPGME) is a library designed to make access to GnuPG easier for applications. It provides a High-Level Crypto API for encryption, decryption, signing, signature verification and key management. Currently it uses GnuPG as its backend but the API isn't restricted to this engine; in fact we have already developed a backend for CMS (S/MIME).

	  http://www.gnupg.org/related_software/gpgme/
```

## package/gcrypt/libassuan/Config.in
```kconfig
config BR2_PACKAGE_LIBASSUAN
	bool "libassuan"
	help
	  GnuPG Made Easy (LIBASSUAN) is a library designed to make access to GnuPG easier for applications. It provides a High-Level Crypto API for encryption, decryption, signing, signature verification and key management. Currently it uses GnuPG as its backend but the API isn't restricted to this engine; in fact we have already developed a backend for CMS (S/MIME).

	  http://www.gnupg.org/related_software/gpgme/
```

## package/gcrypt/libksda/Config.in
```kconfig
config BR2_PACKAGE_LIBKSDA
	bool "libksda"
	help
	  GnuPG Made Easy (LIBKSDA) is a library designed to make access to GnuPG easier for applications. It provides a High-Level Crypto API for encryption, decryption, signing, signature verification and key management. Currently it uses GnuPG as its backend but the API isn't restricted to this engine; in fact we have already developed a backend for CMS (S/MIME).

	  http://www.gnupg.org/related_software/gpgme/
```

## package/kde/dbusmenu-qt/Config.in
```kconfig
config BR2_PACKAGE_DBUSMENU_QT
	bool "dbusmenu-qt"
	help
	   Support for notification area menus via the DBusMenu protocol

	  git://gitorious.org/dbusmenu/dbusmenu-qt.git
```

## package/kde/eigen/Config.in
```kconfig
config BR2_PACKAGE_EIGEN
	bool "eigen"
	help
	  Poppler is a PDF rendering library based on the xpdf-3.0 code base.

	  http://poppler.freedesktop.org/
```

## package/kde/eigen2/Config.in
```kconfig
config BR2_PACKAGE_EIGEN2
	bool "eigen2"
	help
	  Eigen is a C++ template library for linear algebra: matrices, vectors, numerical solvers, and related algorithms.

	  http://eigen.tuxfamily.org
```

## package/kde/grantlee/Config.in
```kconfig
config BR2_PACKAGE_GRANTLEE
	bool "grantlee"
	help
	  Grantlee is a set of Free Software libraries written using the Qt framework.
	  Currently two libraries are shipped with Grantlee: Grantlee Templates and Grantlee TextDocument.

	  https://projects.kde.org/projects/kde/kdelibs/grantlee
```

## package/kde/hupnp/Config.in
```kconfig
config BR2_PACKAGE_HUNPN
	bool "hupnp"
#	depends on BR2_PACKAGE_QT && BR2_PACKAGE_AUTOMOC4
	help
	  Herqq UPnP (HUPnP) is a software library for building UPnP devices and control points conforming to the UPnP Device Architecture version 1.1. It is built using the Qt framework and it enables truly rapid UPnP development.

	  http://www.herqq.org/
```

## package/kde/kactivities/Config.in
```kconfig
config BR2_PACKAGE_KACTIVITIES
	bool "kactivities"
	help
	  API for using and interacting with Activities as a consumer, application adding information to them or as an activity manager.

	  https://projects.kde.org/projects/kde/kdelibs/kactivities
```

## package/kde/kde-runtime/Config.in
```kconfig
config BR2_PACKAGE_KDE_RUNTIME
	bool "kde-runtime"
#	depends on BR2_PACKAGE_QT && BR2_PACKAGE_AUTOMOC4
	help
	  Plugins and applications necessary for the running of KDE applications.

	  http://kde.mirror.aussiehq.net.au/stable/4.7.1/src/
```

## package/kde/kdelibs/Config.in
```kconfig
config BR2_PACKAGE_KDELIBS
	bool "kdelibs"
	help
	  The KDE Library.Sub Projects:
		Activities Library 
		Nepomuk Core 

	  http://kde.mirror.aussiehq.net.au/stable/4.7.1/src/
```

## package/kde/kdepim/Config.in
```kconfig
config BR2_PACKAGE_KDEPIM
	bool "kdepim"
#	depends on BR2_PACKAGE_QT && BR2_PACKAGE_AUTOMOC4
	help
	  Akonadi Server. A cross-desktop storage service for PIM data and meta data providing concurrent read, write, and query access.

	  http://kde.mirror.aussiehq.net.au/stable/4.7.1/src/
```

## package/kde/kdepimlibs/Config.in
```kconfig
config BR2_PACKAGE_KDEPIMLIBS
	bool "kdepimlibs"
	help
	  KDE's Personal Information Management Libraries

	  http://kde.mirror.aussiehq.net.au/stable/4.7.1/src/
```

## package/kde/kdeworkspace/Config.in
```kconfig
config BR2_PACKAGE_KDEWORKSPACE
	bool "kdeworkspace"
#	depends on BR2_PACKAGE_QT && BR2_PACKAGE_AUTOMOC4
	help
	  Provides the interface and basic tools for the KDE workspace.

	  http://kde.mirror.aussiehq.net.au/stable/4.7.1/src/
```

## package/kde/koffice/Config.in
```kconfig
config BR2_PACKAGE_KOFFICE
	bool "koffice"
	help
	  koffice, a free software office suite.

	  http://kde.mirror.aussiehq.net.au/stable/4.7.1/src/
```

## package/kde/nepomuk-core/Config.in
```kconfig
config BR2_PACKAGE_NEPOMUK_CORE
	bool "nepomuk core"
	help
	   The core Nepomuk system contains of the central services like file indexing, file system monitoring, query, and of course storage, as well as the corresponding client libraries.

	  http://dev.nepomuk.semanticdesktop.org/
```

## package/kde/okular/Config.in
```kconfig
config BR2_PACKAGE_OKULAR
	bool "okular"
	help
	  Okular is a universal document viewer based on KPDF for KDE 4. This means Okular works on multiple platforms, including but not limited to Linux, Windows, Mac OS X, *BSD, etc.

	  http://okular.kde.org/
```

## package/kde/openjpeg/Config.in
```kconfig
config BR2_PACKAGE_OPENJPEG
	bool "openjpeg"
	help
	  The spacenav project provides a free, compatible alternative to the proprietary 3Dconnexion device driver and SDK, for their 3D input devices (called "space navigator", "space pilot", "space traveller", etc).

	  http://openjpeg.sourceforge.net/
```

## package/kde/poppler-data/Config.in
```kconfig
config BR2_PACKAGE_POPPLER_DATA
	bool "Poppler-data"
	help
	  Poppler is a PDF rendering library based on the xpdf-3.0 code base.

	  http://poppler.freedesktop.org/
```

## package/kde/poppler/Config.in
```kconfig
config BR2_PACKAGE_POPPLER
	bool "Poppler"
	help
	  Poppler is a PDF rendering library based on the xpdf-3.0 code base.

	  http://poppler.freedesktop.org/
```
