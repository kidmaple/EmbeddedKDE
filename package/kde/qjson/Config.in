## package/kde/qjson/Config.in
```kconfig
config BR2_PACKAGE_QJSON
	bool "qjson"
	help
	   JSON (JavaScript Object Notation) is a lightweight data-interchange format. It can represents integer, real number, string, an ordered sequence of value, and a collection of name/value pairs.

	  http://gitorious.org/qjson
```

## package/kmisc/aspell/Config.in
```kconfig
config BR2_PACKAGE_ASPELL
	bool "aspell"

	help
	  It can either be used as a library or as an independent spell checker.

	http://aspell.net/
```

## package/kmisc/bdb/Config.in
```kconfig
config BR2_PACKAGE_BDB
	bool "bdb"
	help
	  Berkley DB is a set of DB libraries for many types of standard DB table systems. It has a C and C++ interface.

	  http://www.oracle.com/technology/products/berkeley-db/
```

## package/kmisc/create-resources/Config.in
```kconfig
config BR2_PACKAGE_CREATE_RESOURCES
	bool "create-resources"
	help
	  Creative Free and Open Source projects such as Blender, CinePaint, GIMP, Inkscape, Scribus, Audacity, Open Clip Art Library and others are highly successful projects which produce much video, audio, illustrations, photos, and other content. However, much code, media, and infrastructure are produced by each project somewhat independently which could be shared inter-project. For example, several of the aforementioned applications have their own brush types, color preferences, preferred media storage locations, keyboard shortcuts and file format converters. Sharing these resources saves developer time, increases productivity, and contributes to an overall improved user experience. Because of this overlap and the similarity of media, there is need to work together on standards, promotions, and inter-community plans.

	http://create.freedesktop.org/wiki/Main_Page
```

## package/kmisc/docbook-xml/Config.in
```kconfig
config BR2_PACKAGE_DOCBOOK_XML
	bool "DocBook XML"
	help
	  prison is a barcode api currently offering a nice Qt api to produce QRCode barcodes and DataMatrix barcodes, and can easily be made support more.

	  http://www.docbook.org/xml/
```

## package/kmisc/docbook-xsl -ns/Config.in
```kconfig
config BR2_PACKAGE_DOCBOOK_XSL_NS
	bool "DocBook-XSL-NS"
	help
	  The DocBook XSL-NS stylesheets are released side-by-side with the DocBook XSL stylesheets, as a separate docbook-xsl-ns package.

	  http://www.docbook.org/
```

## package/kmisc/evtouch_calibrate/Config.in
```kconfig
config BR2_PACKAGE_XAPP_EVTOUCH_CALIBRATE
	bool "evtouch calibrate"
#	select BR2_PACKAGE_XLIB_LIBX11
	help
	  LibGlade based, graphical calibrator for evtouch touchscreen drivers.
```

## package/kmisc/exiv2/Config.in
```kconfig
config BR2_PACKAGE_EXIV2
	bool "exiv2"
	help
	  Exiv2 is a C++ library and a command line utility to manage image metadata. It provides fast and easy read and write access to the Exif, IPTC and XMP metadata of images in various formats.
	  The Exiv2 library provides
 		- fast read and write access to the Exif, IPTC, and XMP metadata of an image 
		- an easy to use and extensively documented API
		- conversions of Exif and IPTC metadata to XMP and vice versa
		- a smart IPTC implementation that does not affect data that programs like Photoshop store in the same image segment
		- Exif Makernote support:
		  Makernote tags can be read and written just like any other metadata
		  a sophisticated write algorithm avoids corrupting the Makernote
		- a simple interface to extract previews embedded in RAW images and Exif thumbnails
		- set and delete methods for Exif thumbnails

	  http://www.exiv2.org/
```

## package/kmisc/fam/Config.in
```kconfig
config BR2_PACKAGE_FAM
	bool "fam"

	help
	  GUI tools should not mislead the user; they should display the current state of the system, 
	  even when changes to the system originate from outside of the tools themselves. 
	  FAM helps make GUI tools more usable by notifying them when the files they're interested in are created, 
	  modified, executed, and removed.

	http://oss.sgi.com/projects/fam/index.html
```

## package/kmisc/hspell/Config.in
```kconfig
config BR2_PACKAGE_HSPELL
	bool "hspell"

	help
	  The Hspell project is a free Hebrew linguistic project.
	  Its primary goal is to create a free Hebrew spell-checker.

	  In addition to a spell-checker, the project also produced a Hebrew morphological analyzer, 
	  which for every valid Hebrew word lists all of its possible readings (valid combinations of prefix and inflected base word), 
	  and for each reading describe its part-of-speech, gender, tense, and other attributes.

	  The secondary goal of the project is to make the algorithms and dictionaries, created initially for the spell-checker, freely available.

	http://hspell.sourceforge.net/
```

## package/kmisc/ilmbase/Config.in
```kconfig
config BR2_PACKAGE_ILMBASE
	bool "ilmbase"
	help
	  OpenEXR is a high dynamic-range (HDR) image file format developed by Industrial Light & Magic for use in computer imaging applications.

	  http://www.ilmbase.com/
```

## package/kmisc/jasper/Config.in
```kconfig
config BR2_PACKAGE_JASPER
	bool "jasper"

	help
	  This distribution contains the public release of the an open-source implementation of the ISO/IEC 15444-1 
	  also known as JPEG-2000 standard for image compression.

	http://www.ece.uvic.ca/~mdadams/jasper/
```

## package/kmisc/kerberos/Config.in
```kconfig
config BR2_PACKAGE_KERBEROS
	bool "kerberos"
	help
	  Kerberos is a network authentication protocol. It is designed to provide strong authentication for client/server applications by using secret-key cryptography. A free implementation of this protocol is available from the Massachusetts Institute of Technology.

	  http://web.mit.edu/kerberos/www/
```

## package/kmisc/libcanberra/Config.in
```kconfig
config BR2_PACKAGE_LIBCANBERRA
	bool "libcanberra"
	help
	  libcanberra is an implementation of the XDG Sound Theme and Name Specifications, for generating event sounds on free desktops, such as GNOME. It comes with several backends (ALSA, PulseAudio, OSS, GStreamer, null) and is designed to be portable.

	  http://0pointer.de/lennart/projects/libcanberra/
```

## package/kmisc/libdmtx/Config.in
```kconfig
config BR2_PACKAGE_LIBDMTX
	bool "libdmtx"
#	depends on BR2_PACKAGE_QT && BR2_PACKAGE_AUTOMOC4
	help
	  libdmtx is a barcode api currently offering a nice Qt api to produce QRCode barcodes and DataMatrix barcodes, and can easily be made support more.

	  http://kde.mirror.aussiehq.net.au/stable/cagibi/
```

## package/kmisc/libemf/Config.in
```kconfig
config BR2_PACKAGE_LIBEMF
	bool "libemf"
	help
	  libEMF is a C/C++ library which provides a drawing toolkit based on ECMA-234. The general purpose of this library is to create vector graphics files on POSIX systems which can be imported into StarOffice/OpenOffice.org. The Enhanced MetaFile (EMF) is one of the two color vector graphics format which is "vectorially" understood by SO/OO.org. (SO/OO.org can import Encapsulated PostScript files, but will only display it if it has a bitmap preview image. SO/OO.org can also import a DXF file, but as near as I can tell, this is only monochrome. OpenOffice now has an XML based file format; in the future, use of this format will probably supplant this library.) The EMF format also has the additional advantage that it can be "broken" into its constituent components and edited like any other SO/OO.org graphics object.

	  http://libemf.sourceforge.net/
```

## package/kmisc/libgsf/Config.in
```kconfig
config BR2_PACKAGE_LIBGSF
	bool "libgsf"
	help
	  'libgsf' is a simple i/o library that can read and write common file types and handle structured formats that provide file-system-in-a-file semantics. There are some additional utilities for document centric applications.

	  http://libgsf.sourceforge.net/
```

## package/kmisc/libgsl/Config.in
```kconfig
config BR2_PACKAGE_LIBGSL
	bool "libgsl"
	help
	  The library provides a wide range of mathematical routines such as random number generators, special functions and least-squares fitting. There are over 1000 functions in total with an extensive test suite.

	  http://www.gnu.org/s/gsl/
```

## package/kmisc/libical/Config.in
```kconfig
config BR2_PACKAGE_LIBICAL
	bool "libical"
	help
	  The Free Association project maintains libical, an open source reference implementation of the icalendar data type and serialization format. libical is used in dozens of calendaring and scheduling products.

	  http://sourceforge.net/projects/freeassociation/
```

## package/kmisc/libiodbc/Config.in
```kconfig
config BR2_PACKAGE_LIBIODBC
	bool "libiodbc"
	help
	  Independent Open DataBase Connectivity for Linux, MacOS X and Unix systems.

	  http://www.iodbc.org/dataspace/iodbc/wiki/iODBC/
```

## package/kmisc/libspnav/Config.in
```kconfig
config BR2_PACKAGE_LIBSPNAV
	bool "libspnav"
	help
	  The spacenav project provides a free, compatible alternative to the proprietary 3Dconnexion device driver and SDK, for their 3D input devices (called "space navigator", "space pilot", "space traveller", etc).

	  http://libspnav.sourceforge.net/
```

## package/kmisc/libwpd/Config.in
```kconfig
config BR2_PACKAGE_LIBWPD
	bool "libwpd"
	help
	  libwpd is a C++ library designed to help process WordPerfect documents. It is most commonly used to import WordPerfect documents into other word processors (see below), but may be useful in other cases as well.
libwpd exposes a simple callback-based API (similar to SAX), allowing it to be easily plugged into any C or C++ application.

	  http://libwpd.sourceforge.net/
```

## package/kmisc/libwpg/Config.in
```kconfig
config BR2_PACKAGE_LIBWPG
	bool "libwpg"
	help
	  Libwpg project is a collection of library and tools to work with graphics in WPG (WordPerfect Graphics) format. WPG is the format used among others in Corel sofware, such as WordPerfect(tm) and Presentations(tm).

	  http://libwpg.sourceforge.net/
```

## package/kmisc/linux-pam/Config.in
```kconfig
config BR2_PACKAGE_LINUX_PAM
	bool "Linux PAM"
	help
	  TPAM provides a way to develop programs that are independent of authentication scheme.

	  http://ftp.roedu.net/linux/libs/pam/
```

## package/kmisc/mupdf/Config.in
```kconfig
config BR2_PACKAGE_MUPDF
	bool "MuPdf"

	help
	  a lightweight PDF and XPS viewer
	  The renderer in MuPDF is tailored for high quality anti-aliased graphics. It renders text with metrics and spacing accurate to within fractions of a pixel for the highest fidelity in reproducing the look of a printed page on screen.
	  MuPDF is also small, fast, and yet complete. It supports PDF 1.7 with transparency, encryption, hyperlinks, annotations, searching and more. It also reads OpenXPS documents.

	http://www.mupdf.com/
```
